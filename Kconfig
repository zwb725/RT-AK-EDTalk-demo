## Kconfig
```kconfig
menu "RT-AK Edgi"

menuconfig RT_AI_USE_EDGI
    bool "Enable RT-AK Edgi backend"
    default n
    help
        Enable RT-AK backend adapter for Edgi Talk / DeepCraft /
        Cortex-M55 / Ethos-U55 model inference.

        This option only enables the RT-AK backend and minimal demo.
        It does not enable UVC camera, LCD overlay or model-specific
        postprocess logic.

if RT_AI_USE_EDGI

choice
    prompt "Select Edgi AI model"
    default RT_AI_EDGI_MODEL_OBJECT_DETECT

config RT_AI_EDGI_MODEL_OBJECT_DETECT
    bool "Object detect model"
    help
        Build the current DeepCraft object detection model.
        Only one Edgi model is linked into the firmware.

endchoice

# Future model choices can be added here, for example
# RT_AI_EDGI_MODEL_HAND_GESTURE or RT_AI_EDGI_MODEL_FACE_DETECT.

config RT_AI_USE_M55_ETHOSU
    bool "Enable Cortex-M55 / Ethos-U55 runtime binding"
    default y
    help
        Enable the Edgi backend path targeting Cortex-M55 and Ethos-U55.
        The actual Ethos-U55 / TFLM / DeepCraft runtime is still provided
        by the existing Edgi Talk BSP.

config RT_AI_EDGI_MINIMAL_DEMO
    bool "Enable Edgi RT-AK minimal MSH demo"
    default y
    help
        Build rt_ai_edgi_minimal_demo command for board-side validation.

config RT_AI_EDGI_RUNNER
    bool "Enable Edgi RT-AK config runner API"
    default y
    help
        Build the reusable config-driven runner API. BSP application code
        can feed preprocessed frames into this runner without depending on
        model-specific RT-AK calls.

config RT_AI_EDGI_RUNNER_DEMO
    bool "Enable Edgi RT-AK config runner demo"
    depends on RT_AI_EDGI_RUNNER
    default y
    help
        Build rt_ai_edgi_runner_demo command. This command uses the
        generated runner configuration to call rt_ai_find, rt_ai_init,
        rt_ai_input, rt_ai_run and rt_ai_output through a reusable runner.
        UVC capture and LCD overlay remain in BSP application code.

endif

endmenu
```

## applications/rt_ai_edgi/Kconfig
```kconfig
menu "RT-AK Edgi"

menuconfig RT_AI_USE_EDGI
    bool "Enable RT-AK Edgi backend"
    default n
    help
        Enable RT-AK backend adapter for Edgi Talk / DeepCraft /
        Cortex-M55 / Ethos-U55 model inference.

        This option only enables the RT-AK backend and minimal demo.
        It does not enable UVC camera, LCD overlay or model-specific
        postprocess logic.

if RT_AI_USE_EDGI

config RT_AI_USE_M55_ETHOSU
    bool "Enable Cortex-M55 / Ethos-U55 runtime binding"
    default y
    help
        Enable the Edgi backend path targeting Cortex-M55 and Ethos-U55.
        The actual Ethos-U55 / TFLM / DeepCraft runtime is still provided
        by the existing Edgi Talk BSP.

config RT_AI_EDGI_MINIMAL_DEMO
    bool "Enable Edgi RT-AK minimal MSH demo"
    default y
    help
        Build rt_ai_edgi_rtak_api_demo command for board-side validation.

endif

endmenu
```
